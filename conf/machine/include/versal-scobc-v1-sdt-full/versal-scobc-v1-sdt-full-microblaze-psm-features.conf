## conf/machine/include/versal-scobc-v1-sdt-full/versal-scobc-v1-sdt-full-microblaze-psm-features.conf
```bitbake
MACHINE_FEATURES = "cframe cfupmc common csudma emacps gpiops iomodule ipipsu qspipsu rtcpsu sdps spips sysmonpsv tmr-inject tmr-manager trngpsv ttcps uartlite uartpsv usbpsu zdma"
```

## meta-scobc-dualboot/conf/layer.conf
```bitbake
# We have a conf and classes directory, add to BBPATH
BBPATH .= ":${LAYERDIR}"

# We have recipes-* directories, add to BBFILES
BBFILES += "${LAYERDIR}/recipes-*/*/*.bb \
            ${LAYERDIR}/recipes-*/*/*.bbappend"

BBFILE_COLLECTIONS += "scobc-dualboot"
BBFILE_PATTERN_scobc-dualboot = "^${LAYERDIR}/"
BBFILE_PRIORITY_scobc-dualboot = "6"

LAYERDEPENDS_scobc-dualboot = "meta-scobc-v1"
LAYERSERIES_COMPAT_scobc-dualboot = "scarthgap"

DISTRO_FEATURES:append = " rauc"

RAUC_BUNDLE_VERSION ?= "${DISTRO_VERSION}"
RAUC_KEY_FILE ?= "${LAYERDIR}/recipes-core/rauc/rauc-cert-example/development-1.key.pem"
RAUC_CERT_FILE ?= "${LAYERDIR}/recipes-core/rauc/rauc-cert-example/development-1.cert.pem"
RAUC_KEYRING_FILE ?= "${LAYERDIR}/recipes-core/rauc/rauc-cert-example/ca.cert.pem"
```

## meta-scobc-dualboot/conf/machine/include/versal-scobc-v1-sdt-full/uboot-config.conf
```bitbake
# Enable redundant boot configuration (dualboot)
# Build two U-Boot variants: "golden" and "main"
UBOOT_MACHINE = ""
UBOOT_CONFIG  = "golden main"

UBOOT_CONFIG[main]   = "xilinx_versal_virt_defconfig"
UBOOT_CONFIG[golden] = "xilinx_versal_virt_defconfig"
```

## meta-scobc-v1/conf/layer.conf
```bitbake
# We have a conf and classes directory, add to BBPATH
BBPATH .= ":${LAYERDIR}"

# We have recipes-* directories, add to BBFILES
BBFILES += "${LAYERDIR}/recipes-*/*/*.bb \
            ${LAYERDIR}/recipes-*/*/*.bbappend"

BBFILE_COLLECTIONS += "meta-scobc-v1"
BBFILE_PATTERN_meta-scobc-v1 = "^${LAYERDIR}/"
BBFILE_PRIORITY_meta-scobc-v1 = "6"

LAYERDEPENDS_meta-scobc-v1 = "core"
LAYERSERIES_COMPAT_meta-scobc-v1 = "scarthgap"
```

## meta-scobc-v1/conf/machine/include/dualboot.inc
```bitbake
# Enable redundant boot configuration (dualboot)
# Build two U-Boot variants: "golden" and "main"
UBOOT_MACHINE = ""
UBOOT_CONFIG = "golden main"

UBOOT_CONFIG[golden]  = "xilinx_versal_dualboot_golden_defconfig"
UBOOT_CONFIG[main] = "xilinx_versal_dualboot_main_defconfig"

# Append 'dualboot' to OVERRIDES so other recipes (e.g. xilinx-bootbin)
# can add dualboot-specific behavior.
OVERRIDES:append = ":dualboot"
```

## meta-scobc-v1/conf/machine/include/versal-scobc-v1-sdt-full/versal-scobc-v1-sdt-full-microblaze-pmc-features.conf
```bitbake
MACHINE_FEATURES = "cframe cfupmc common csudma emacps gpiops iomodule ipipsu qspipsu rtcpsu sdps spips sysmonpsv tmr-inject tmr-manager trngpsv uartlite uartpsv usbpsu zdma"
```

## meta-scobc-v1/conf/machine/include/versal-scobc-v1-sdt-full/versal-scobc-v1-sdt-full-microblaze-psm-features.conf
```bitbake
MACHINE_FEATURES = "canfd cframe cfupmc common csudma emacps gpiops iic iicps iomodule ipipsu qspipsu rtcpsu sdps spips sysmonpsv tmr-inject tmr-manager trngpsv ttcps uartlite uartpsv usbpsu zdma"
```

## meta-scobc/conf/machine/include/versal-scobc-v1-ve2002e-sdt-full/versal-scobc-v1-ve2002e-sdt-full-microblaze-pmc-features.conf
```bitbake
MACHINE_FEATURES = "cframe cfupmc common csudma emacps gpiops iomodule ipipsu qspipsu sdps spips sysmonpsv trngpsv ttcps uartlite uartpsv usbpsu wdttb zdma"
```
